## main/Kconfig.projbuild
```kconfig
menu "Client Configuration"

    config WIFI_SSID
        string "WiFi SSID"
        default "ESP32_S3_Display"
        help
            SSID of the WiFi network.

    config WIFI_PASSWORD
        string "WiFi Password"
        default "12345678"
        help
            Password for the WiFi network.

    config TCP_SERVER_IP
        string "TCP Server IP"
        default "192.168.4.1"
        help
            IP address of the TCP server.

    config TCP_SERVER_PORT
        int "TCP Server Port"
        default 8888
        help
            Port of the TCP server.

    config DEVICE_NAME
        string "Device Name (English)"
        default "pomodoro"
        help
            Name of the device (used in JSON and log files). Use only English letters.

    config COMMAND_PORT
        int "Command Server Port"
        default 8889
        help
            Port on which the device listens for commands from the server.

endmenu

menu "Motor Control Configuration"

    config PUMP_PWM_GPIO
        int "GPIO for pump PWM (ENA)"
        default 6
        range 0 21
        help
            GPIO pin for PWM speed control of the pump.

    config PUMP_IN1_GPIO
        int "GPIO for pump enable (IN1)"
        default 7
        range 0 21
        help
            GPIO pin that turns the pump ON (HIGH) or OFF (LOW).

    config VALVE_GPIO
        int "GPIO for valve control (IN3)"
        default 4
        range 0 21
        help
            GPIO pin to open (HIGH) or close (LOW) the valve.

     config PUMP_SPEED
        int "Default pump speed (%)"
        default 70
        range 0 100
        help
            Default speed of the pump in percent (0-100).
            This value is used at startup and if not changed by command.

endmenu

menu "Button Configuration"

    config BUTTON_GPIO
        int "GPIO for reset button"
        default 10
        range 0 21
        help
            GPIO pin connected to a button that will restart the ESP32-C3.

endmenu

menu "calibration of humidity sensors"

    config DRY_MV
        int "Dry value (ADC) for HW-390"
        default 2785
        range 0 3300
        help
            Raw ADC reading in millivolts (0–3300 mV) corresponding to dry soil.
            This value should be greater than WET_MV because the sensor output
            voltage decreases as moisture increases.

    config WET_MV
        int "Wet value (ADC) for HW-390"
        default 1320
        range 0 3300
        help
            Raw ADC reading in millivolts (0–3300 mV) corresponding to wet soil.
            This value should be less than DRY_MV.
endmenu

menu "Irrigation Control Configuration"

    config MOISTURE_THRESHOLD
        int "Moisture threshold (%) for automatic pump start"
        default 70
        range 0 100
        help
            If moisture is below this value and other conditions are met, pump starts automatically.

    config PUMP_START_HOUR
        int "Pump start hour (24h format)"
        default 7
        range 0 23
        help
            Hour from which automatic pump operation is allowed.

    config PUMP_END_HOUR
        int "Pump end hour (24h format)"
        default 11
        range 0 23
        help
            Hour until which automatic pump operation is allowed.

    config PUMP_STOP_DELAY_AFTER_NO_WATER
        int "Delay (seconds) to stop pump after no water detected (level2=0)"
        default 10
        range 1 60
        help
            Time to wait after level2 becomes 0 before stopping the pump (debounce).

    config MAX_PUMP_RUN_TIME
        int "Maximum pump run time (minutes)"
        default 10
        range 1 120
        help
            Maximum continuous run time for the pump. After this time, pump will stop automatically.

    config VALVE_OPEN_DELAY_AFTER_PUMP_STOP
        int "Delay (seconds) to open valve after pump stops"
        default 30
        range 0 120
        help
            Time to wait after pump stops before opening the valve.

    config LEVEL_DEBOUNCE_DELAY
        int "Debounce delay (seconds) for level sensors"
        default 5
        range 1 20
        help
            Time to wait before sending level change events to avoid false triggers.

endmenu

menu "BLE Configuration"
    config BLE_ENABLE
        bool "Enable Bluetooth LE (BLE) for monitoring and OTA"
        default n
        help
            If enabled, ESP32-C3 will act as a BLE peripheral with UART service.
            You can connect from a computer/phone to receive logs and send OTA firmware.

    config BLE_DEVICE_NAME
        string "BLE Device Name"
        depends on BLE_ENABLE
        default "Irrigation_Node"
        help
            Name of the BLE device as seen during scanning.

endmenu

menu "Remote Control Configuration"

    config LOG_STREAM_PORT
        int "TCP port for log streaming"
        default 8890
        range 1024 65535
        help
            Port on which the lower device will send logs in real-time.

    config OTA_RECOVERY_PORT
        int "TCP port for OTA recovery server"
        default 8891
        range 1024 65535
        help
            Port on which the lower device will listen for firmware updates in recovery mode.

endmenu
```
